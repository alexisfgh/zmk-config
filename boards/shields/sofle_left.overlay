&spi1 {
    status = "okay";

    nice_view_spi: nice_view_spi@0 {
        compatible = "zmk,nice-view";
        reg = <0>;
        label = "NiceView";
        spi-max-frequency = <4000000>;
        cs-gpios = <&gpio0 25 GPIO_ACTIVE_LOW>;  // reemplaza por el pin real del CS
        reset-gpios = <&gpio0 11 GPIO_ACTIVE_LOW>;  // opcional, si usas reset
    };
};
